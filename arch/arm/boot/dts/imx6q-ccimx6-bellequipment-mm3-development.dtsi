/*
 * Copyright 2014-2018 Digi International, Inc.
 *
 * The code contained herein is licensed under the GNU General Public
 * License. You may obtain a copy of the GNU General Public License
 * Version 2 or later at the following locations:
 *
 * http://www.opensource.org/licenses/gpl-license.html
 * http://www.gnu.org/copyleft/gpl.html
 */

/* ConnectCore 6 Bell Equipment MM3 Development */
#include "imx6qdl-ccimx6-bellequipment-mm3-development.dtsi"

/ {
	model = "ConnectCore 6 Bell Equipment Memory Module 3.";
	compatible = "digi,ccimx6", "fsl,imx6q";
	digi,machine,name = "ccimx6-bellequipment-mm3-development";

	aliases {
		rtc0 = &rtc_read;
		rtc1 = &snvs;
	};
};

&v4l2_cap_0 {
	ipu_id = <1>;
	csi_id = <0>;
};

&v4l2_cap_1 {
	ipu_id = <0>;
	csi_id = <0>;
};

